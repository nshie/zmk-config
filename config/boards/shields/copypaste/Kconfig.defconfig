## config/boards/shields/copypaste/Kconfig.defconfig
```kconfig
if SHIELD_COPYPASTE_LEFT

config ZMK_KEYBOARD_NAME
    default "CopyPaste"

config ZMK_SPLIT_ROLE_CENTRAL
    default y

endif

if SHIELD_COPYPASTE_LEFT || SHIELD_COPYPASTE_RIGHT

config ZMK_SPLIT
    default y

endif
```

## config/boards/shields/copypaste/Kconfig.shield
```kconfig
config SHIELD_COPYPASTE_LEFT
    def_bool $(shields_list_contains,copypaste_left)

config SHIELD_COPYPASTE_RIGHT
    def_bool $(shields_list_contains,copypaste_right)
```

## config/west.yml
```yaml
manifest:
  remotes:
    - name: zmkfirmware
      url-base: https://github.com/zmkfirmware
    - name: phloamy
      url-base: https://github.com/phloamy
    - name: steno
      url-base: https://github.com/dnaq
  projects:
    - name: zmk
      remote: steno
      revision: plover-hid-hog-attempt
      import: app/west.yml
  self:
    path: config
```
